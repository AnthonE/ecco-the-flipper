## esp32/sdkconfig.defaults
```kconfig
# ESP32-S2 config for Ecco
CONFIG_IDF_TARGET="esp32s2"

# WiFi
CONFIG_ESP_WIFI_SOFTAP_SUPPORT=y
CONFIG_ESP_WIFI_AP_MAX_STA_CONN=4

# HTTP Server
CONFIG_HTTPD_MAX_REQ_HDR_LEN=1024
CONFIG_HTTPD_MAX_URI_LEN=512
CONFIG_HTTPD_WS_SUPPORT=y

# UART
CONFIG_UART_ISR_IN_IRAM=y

# Stack sizes
CONFIG_ESP_MAIN_TASK_STACK_SIZE=8192
CONFIG_PTHREAD_TASK_STACK_SIZE_DEFAULT=4096
```
